    
/ {
  behaviors {
    // Added for testing
        HRM_RGUI: HRM_RGUI {
            compatible = "zmk,behavior-hold-tap";
            label = "HRM_RGUI";
            bindings = <&kp>, <&kp>;

            #binding-cells = <2>;
            tapping-term-ms = <300>;
            flavor = "tap-preferred";
            hold-trigger-key-positions = <0 1 3 4 5 12 13 14 15 16 17 24 25 26 27 28 34 35 36 2>;
            quick-tap-ms = <200>;
            hold-trigger-on-release;
        };

        HRM_LGUI: HRM_LGUI {
            compatible = "zmk,behavior-hold-tap";
            label = "HRM_LGUI";
            bindings = <&kp>, <&kp>;

            #binding-cells = <2>;
            tapping-term-ms = <300>;
            flavor = "tap-preferred";
            hold-trigger-key-positions = <6 7 8 10 11 18 19 20 21 22 23 29 30 31 32 33 37 38 39 9>;
            quick-tap-ms = <200>;
            hold-trigger-on-release;
        };

        HRM_RCTRL: HRM_RCTRL {
            compatible = "zmk,behavior-hold-tap";
            label = "HRM_RCTRL";
            bindings = <&kp>, <&kp>;

            #binding-cells = <2>;
            tapping-term-ms = <300>;
            flavor = "tap-preferred";
            hold-trigger-key-positions = <0 1 3 4 5 12 13 14 15 16 17 24 25 26 27 28 34 35 36 2>;
            quick-tap-ms = <200>;
            hold-trigger-on-release;
        };

        HRM_RALT: HRM_RALT {
            compatible = "zmk,behavior-hold-tap";
            label = "HRM_RALT";
            bindings = <&kp>, <&kp>;

            #binding-cells = <2>;
            tapping-term-ms = <300>;
            flavor = "tap-preferred";
            hold-trigger-key-positions = <0 1 3 4 5 12 13 14 15 16 17 24 25 26 27 28 34 35 36 2>;
            quick-tap-ms = <200>;
            hold-trigger-on-release;
        };

        HRM_LCTRL: HRM_LCTRL {
            compatible = "zmk,behavior-hold-tap";
            label = "HRM_LCTRL";
            bindings = <&kp>, <&kp>;

            #binding-cells = <2>;
            tapping-term-ms = <300>;
            flavor = "tap-preferred";
            hold-trigger-key-positions = <6 7 8 11 18 19 20 21 22 23 29 30 31 32 33 37 38 39 9 10>;
            quick-tap-ms = <200>;
            hold-trigger-on-release;
        };

        HRM_LALT: HRM_LALT {
            compatible = "zmk,behavior-hold-tap";
            label = "HRM_LALT";
            bindings = <&kp>, <&kp>;

            #binding-cells = <2>;
            tapping-term-ms = <300>;
            flavor = "tap-preferred";
            hold-trigger-key-positions = <6 11 18 19 20 21 22 23 29 30 31 32 33 37 38 39 7 8 10 11 19 20 21 22 9>;
            quick-tap-ms = <200>;
            hold-trigger-on-release;
        };

        SPACE_NAVNUM: SPACE_NAVNUM {
            compatible = "zmk,behavior-hold-tap";
            label = "SPACE_NAVNUM";
            bindings = <&mo>, <&kp>;

            #binding-cells = <2>;
            flavor = "tap-preferred";
            tapping-term-ms = <300>;
            quick-tap-ms = <200>;
        };

        ENTER_FUNCTIONS: ENTER_FUNCTIONS {
            compatible = "zmk,behavior-hold-tap";
            label = "ENTER_FUNCTIONS";
            bindings = <&mo>, <&kp>;

            #binding-cells = <2>;
            flavor = "hold-preferred";
            tapping-term-ms = <300>;
            hold-trigger-key-positions = <37 0 1 2 3 4 5 6 7 8 9 10 11 12 13 14 15 16 17 18 19 20 21 22 23 24 25 26 27 28 29 30 31 32 33>;
            quick-tap-ms = <200>;
        };

        TAB_FUNCTIONS: TAB_FUNCTIONS {
            compatible = "zmk,behavior-hold-tap";
            label = "TAB_FUNCTIONS";
            bindings = <&mo>, <&kp>;

            #binding-cells = <2>;
            flavor = "hold-preferred";
            tapping-term-ms = <300>;
            hold-trigger-key-positions = <36 0 1 2 3 4 5 6 7 8 9 10 11 12 13 14 15 16 17 18 19 20 21 22 23 24 25 26 27 28 29 30 31 32 33>;
            quick-tap-ms = <200>;
        };

        BCKSPC_NAVNUM: BCKSPC_NAVNUM {
            compatible = "zmk,behavior-hold-tap";
            label = "BCKSPC_NAVNUM";
            bindings = <&mo>, <&kp>;

            #binding-cells = <2>;
            flavor = "hold-preferred";
            tapping-term-ms = <300>;
            hold-trigger-key-positions = <35 6 7 8 9 10 11 18 19 20 21 22 23 29 30 31 32 33 0 1 2 3 4 5 12 13 14 15 16 17 24 25 26 27 28>;
            quick-tap-ms = <200>;
        };
    };